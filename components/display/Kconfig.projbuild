## components/display/Kconfig.projbuild
```kconfig
menu "Display / Touch Configuration"

config TOUCH_Z_THRESHOLD
    int "XPT2046 touch pressure threshold (z1 + 4095 - z2)"
    default 300
    range 10 4000
    help
        触摸压力判定阈值。数值越小越灵敏。
        实测: 未按下时 z1+4095-z2 接近 0, 按下时通常 > 300。

config TOUCH_X_MIN
    int "XPT2046 raw X at screen left edge"
    default 200

config TOUCH_X_MAX
    int "XPT2046 raw X at screen right edge"
    default 3900

config TOUCH_Y_MIN
    int "XPT2046 raw Y at screen top edge"
    default 240

config TOUCH_Y_MAX
    int "XPT2046 raw Y at screen bottom edge"
    default 3800

config TOUCH_SWAP_XY
    bool "Swap touch X/Y axes"
    default y
    help
        实测该面板(店家 XPT2406)原始轴与屏幕轴互换, 默认开启。
        若四角对照发现反了再关闭。

config TOUCH_MIRROR_X
    bool "Mirror touch X axis"
    default n

config TOUCH_MIRROR_Y
    bool "Mirror touch Y axis"
    default n

endmenu
```

## components/input/Kconfig.projbuild
```kconfig
menu "Knob Input"

    config KNOB_INPUT_POLL_MS
        int "Knob position poll interval (ms)"
        default 5
        range 1 50

    config KNOB_INPUT_QUEUE_LEN
        int "Knob event queue length"
        default 16
        range 4 64

endmenu
```

## components/motor/Kconfig.projbuild
```kconfig
menu "Motor Knob Configuration"

    config MOTOR_ENABLE
        bool "Enable BLDC motor knob"
        default y

    config MOTOR_PWM_A
        int "Phase A PWM pin"
        default 15

    config MOTOR_PWM_B
        int "Phase B PWM pin"
        default 16

    config MOTOR_PWM_C
        int "Phase C PWM pin"
        default 17

    config MOTOR_EN_PIN
        int "Driver enable pin (-1 to disable)"
        default 18

    choice MOTOR_MT6701_INTERFACE
        prompt "MT6701 interface mode"
        default MOTOR_MT6701_INTERFACE_ABZ

        config MOTOR_MT6701_INTERFACE_ABZ
            bool "ABZ incremental encoder (M-Creation module default)"

        config MOTOR_MT6701_INTERFACE_SSI
            bool "SSI (CSN fixed to GND)"

        config MOTOR_MT6701_INTERFACE_I2C
            bool "I2C (requires CSN tied to VDD)"
    endchoice

    config MOTOR_MT6701_ABZ_A_PIN
        int "ABZ A-phase input pin (module SDA)"
        default 7

    config MOTOR_MT6701_ABZ_B_PIN
        int "ABZ B-phase input pin (module SCL)"
        default 4

    config MOTOR_MT6701_ABZ_PPR
        int "ABZ pulses per revolution"
        default 1024

    config MOTOR_MT6701_SCL
        int "MT6701 SCL/CLK pin"
        default 4

    config MOTOR_MT6701_SDA
        int "MT6701 SDA/DO pin"
        default 7

    config MOTOR_MT6701_CS
        int "MT6701 CSN pin (SSI mode only)"
        default 3

    config MOTOR_POLE_PAIRS
        int "Motor pole pairs"
        default 7

    config MOTOR_VOLTAGE_SUPPLY
        int "Motor power supply voltage (V)"
        default 12

    config MOTOR_VOLTAGE_LIMIT
        int "Motor voltage limit (V)"
        default 5

    config MOTOR_TASK_CORE
        int "Motor task CPU core"
        default 1

endmenu
```

## components/mqtt_ha/Kconfig.projbuild
```kconfig
config MQTT_HA_ENABLE
    bool "Upload SCD40 data to Home Assistant via MQTT"
    default n
    help
        Enable publishing CO2/temp/humidity to a Home Assistant MQTT broker.

menu "MQTT HA Broker"
    depends on MQTT_HA_ENABLE

    config MQTT_HA_BROKER_URI
        string "Broker URI"
        default "mqtt://192.168.1.100:1883"
        help
            e.g. mqtt://192.168.1.100:1883  (or mqtts:// if TLS)

    config MQTT_HA_USERNAME
        string "Username"
        default ""

    config MQTT_HA_PASSWORD
        string "Password"
        default ""

    config MQTT_HA_CLIENT_ID
        string "Client ID / device name"
        default "SmartKnob"
        help
            Used in MQTT client ID and in Home Assistant discovery entity names.

    config MQTT_HA_TOPIC
        string "HASS control topic prefix"
        default "knob"
        help
            X-Knob style: control commands are published to <topic>/HOME/<device>
            with payload LEFT / RIGHT / ON / OFF.
endmenu
```

## components/scd40/Kconfig.projbuild
```kconfig
menu "SCD40 CO2 Sensor"

config SCD40_SDA_PIN
    int "SCD40 SDA GPIO number"
    default 5

config SCD40_SCL_PIN
    int "SCD40 SCL GPIO number"
    default 6

config SCD40_POLL_INTERVAL_MS
    int "SCD40 poll interval in ms (measurement cycle is 5000 ms)"
    default 5000

config SCD40_I2C_SPEED_HZ
    int "SCD40 I2C clock speed in Hz"
    default 100000

endmenu
```

## components/webcfg/Kconfig.projbuild
```kconfig
menu "Web Config & OTA"

config WEBCFG_ENABLE
    bool "Enable web config server and OTA"
    default y
    help
        Starts an HTTP server on the knob that hosts a config page
        (WiFi/MQTT settings stored in NVS) and firmware upload (OTA).

config WEBCFG_HTTP_PORT
    int "HTTP server port"
    default 80
    range 1 65535
    depends on WEBCFG_ENABLE

endmenu
```

## components/wifi/Kconfig.projbuild
```kconfig
menu "WiFi Configuration"

    config ESP_WIFI_SSID
        string "WiFi SSID"
        default "myssid"
        help
            Your WiFi network name.

    config ESP_WIFI_PASS
        string "WiFi Password"
        default "mypassword"
        help
            Your WiFi password.

    config ESP_WIFI_MAX_RETRY
        int "Max connection retries"
        default 5
        help
            已废弃: 现为无限重连(断网自愈 + AP 配网依赖)。

    config WIFI_AP_FALLBACK_ENABLE
        bool "Enable SoftAP provisioning fallback"
        default y
        help
            开机等待 STA 连接超时后自动开启热点(配网模式),
            屏幕显示热点名/IP/二维码, 浏览器打开原管理页改 WiFi。
            配网成功后热点自动关闭。

    config WIFI_AP_FALLBACK_TIMEOUT_SEC
        int "SoftAP fallback timeout (seconds)"
        default 90
        range 15 600
        depends on WIFI_AP_FALLBACK_ENABLE

    config WIFI_AP_PASSWORD
        string "SoftAP password (empty = open network)"
        default ""
        depends on WIFI_AP_FALLBACK_ENABLE

endmenu
```

## sdkconfig.defaults
```kconfig
CONFIG_IDF_TARGET="esp32s3"
CONFIG_ESPTOOLPY_FLASHSIZE_16MB=y
CONFIG_ESPTOOLPY_FLASHSIZE="16MB"
CONFIG_PARTITION_TABLE_CUSTOM=y
CONFIG_PARTITION_TABLE_CUSTOM_FILENAME="partitions.csv"
CONFIG_PARTITION_TABLE_FILENAME="partitions.csv"
# ---- CPU ----
CONFIG_ESP_DEFAULT_CPU_FREQ_MHZ_160=y
CONFIG_ESP_DEFAULT_CPU_FREQ_MHZ=160
CONFIG_ESP32S3_DEFAULT_CPU_FREQ_160=y
CONFIG_ESP32S3_DEFAULT_CPU_FREQ_MHZ=160
CONFIG_ESP_TASK_WDT_EN=y
CONFIG_ESP_TASK_WDT_INIT=y
CONFIG_ESP_TASK_WDT_TIMEOUT_S=5
CONFIG_ESP_TASK_WDT_CHECK_IDLE_TASK_CPU0=y
CONFIG_ESP_TASK_WDT_CHECK_IDLE_TASK_CPU1=y
CONFIG_MOTOR_ENABLE=y
CONFIG_MOTOR_PWM_A=15
CONFIG_MOTOR_PWM_B=16
CONFIG_MOTOR_PWM_C=17
CONFIG_MOTOR_EN_PIN=18
CONFIG_MOTOR_MT6701_INTERFACE_ABZ=y
CONFIG_MOTOR_MT6701_ABZ_A_PIN=7
CONFIG_MOTOR_MT6701_ABZ_B_PIN=4
CONFIG_MOTOR_MT6701_ABZ_PPR=1024
CONFIG_MOTOR_POLE_PAIRS=7
CONFIG_MOTOR_VOLTAGE_SUPPLY=12
CONFIG_MOTOR_VOLTAGE_LIMIT=5
CONFIG_MOTOR_TASK_CORE=1
# ---- SCD40 ----
CONFIG_SCD40_SDA_PIN=5
CONFIG_SCD40_SCL_PIN=6
CONFIG_SCD40_POLL_INTERVAL_MS=2000
CONFIG_SCD40_I2C_SPEED_HZ=100000
CONFIG_MQTT_HA_ENABLE=y
CONFIG_MQTT_HA_TOPIC="knob"
CONFIG_WEBCFG_ENABLE=y
CONFIG_WEBCFG_HTTP_PORT=80
CONFIG_LV_COLOR_DEPTH_16=y
CONFIG_LV_COLOR_DEPTH=16
CONFIG_LV_MEM_SIZE_KILOBYTES=64
# LVGL 用 stdlib malloc: 内部 RAM 优先, 满了自动落 PSRAM
# (builtin 固定 64KB 池不可扩展, 页面叠加时 OOM 死循环)
CONFIG_LV_USE_STDLIB_MALLOC=y
CONFIG_LV_FONT_MONTSERRAT_8=y
CONFIG_LV_FONT_MONTSERRAT_14=y
CONFIG_LV_FONT_MONTSERRAT_26=y
CONFIG_LV_FONT_MONTSERRAT_48=y
CONFIG_LV_USE_SCALE=y
CONFIG_LV_USE_QRCODE=y
CONFIG_LV_USE_OS=0
CONFIG_ESP_CONSOLE_UART_DEFAULT=y
CONFIG_ESP_CONSOLE_UART_BAUDRATE=115200
CONFIG_BT_ENABLED=y
CONFIG_BT_NIMBLE_ENABLED=y
CONFIG_BT_NIMBLE_NVS_PERSIST=y
CONFIG_ESP_WIFI_STATIC_RX_BUFFER_NUM=6
CONFIG_ESP_WIFI_DYNAMIC_RX_BUFFER_NUM=6
CONFIG_ESP_WIFI_DYNAMIC_TX_BUFFER_NUM=6
CONFIG_ESP_WIFI_MGMT_SBUF_NUM=6
CONFIG_SPIRAM=y
CONFIG_SPIRAM_MODE_OCT=y
CONFIG_SPIRAM_SPEED_80M=y
CONFIG_SPIRAM_USE_MALLOC=y
CONFIG_SPIRAM_MALLOC_ALWAYSINTERNAL=16384
CONFIG_SPIRAM_MALLOC_RESERVE_INTERNAL=32768
# BLE HID 真正连上后 NimBLE 运行期分配会吃穿内部 RAM(WiFi 发帧
# 分配失败 TCP 重传死循环, web 全瘫) —— BLE 栈与 WiFi/lwip 动态
# 缓冲都放 PSRAM(S3 GDMA 支持)
CONFIG_BT_NIMBLE_MEM_ALLOC_MODE_EXTERNAL=y
CONFIG_SPIRAM_TRY_ALLOCATE_WIFI_LWIP=y
CONFIG_LV_DEF_REFR_PERIOD=16
CONFIG_TOUCH_SWAP_XY=n
CONFIG_FREERTOS_GENERATE_RUN_TIME_STATS=y
```
